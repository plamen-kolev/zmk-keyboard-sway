## boards/shields/sway/Kconfig.shield
```kconfig
# Copyright (c) 2022 The ZMK Contributors
# SPDX-License-Identifier: MIT

config SHIELD_SWAY_LEFT
    def_bool $(shields_list_contains,sway_left)

config SHIELD_SWAY_RIGHT
    def_bool $(shields_list_contains,sway_right)
```

## west.yml
```yaml
manifest:
  remotes:
    - name: petejohanson
      url-base: https://github.com/petejohanson
  projects:
    # Together with the above defined remote, this refers to a module located at
    # https://github.com/remote-name/repository-name
    - name: cirque-input-module
      revision: main
      remote: petejohanson
      # This points to a west manifest file in the remote module for further imports
      import: west.yml
```
