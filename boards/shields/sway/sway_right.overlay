/*
 * Copyright (c) 2022 The ZMK Contributors
 *
 * SPDX-License-Identifier: MIT
 */

#include "sway.dtsi"

/ {
    chosen {
        zmk,kscan = &kscan0;
    };

};

&right_encoder1 {
    status = "okay";
    a-gpios = <&pro_micro 16 GPIO_PULL_UP>;
    b-gpios = <&pro_micro 10 GPIO_PULL_UP>;
};

&default_transform {
    col-offset = <5>;
};
